## cam_s3/main/Kconfig.projbuild
```kconfig
menu "Freenove camera"
    config CAM_AP_SSID
        string "Wi-Fi access point name"
        default "JC8012-CAM"
    config CAM_AP_PASSWORD
        string "Wi-Fi password (min. 8 characters)"
        default "jc8012cam"
    config CAM_AP_CHANNEL
        int "Wi-Fi channel"
        range 1 13
        default 1
    choice CAM_JPEG_FRAMESIZE
        prompt "Picture size for sensors with JPEG output (OV2640, OV3660, OV5640)"
        default CAM_JPEG_FRAMESIZE_SVGA
        config CAM_JPEG_FRAMESIZE_SVGA
            bool "SVGA 800x600"
        config CAM_JPEG_FRAMESIZE_XGA
            bool "XGA 1024x768"
        config CAM_JPEG_FRAMESIZE_HD
            bool "HD 1280x720"
        config CAM_JPEG_FRAMESIZE_UXGA
            bool "UXGA 1600x1200"
    endchoice
    config CAM_SENSOR_JPEG_QUALITY
        int "Sensor JPEG quality (0-63, lower = better, larger frames)"
        range 0 63
        default 12
    choice CAM_FRAMESIZE
        prompt "Picture size for sensors without JPEG output (GC0308)"
        default CAM_FRAMESIZE_VGA
        help
            The GC0308 sensor delivers at most 640x480.
        config CAM_FRAMESIZE_VGA
            bool "VGA 640x480"
        config CAM_FRAMESIZE_QVGA
            bool "QVGA 320x240"
    endchoice
    config CAM_JPEG_QUALITY
        int "S3 encoder JPEG quality for sensors without JPEG output (1-100, higher = better)"
        range 1 100
        default 60
    config CAM_ROTATE_180
        bool "Rotate the picture by 180 degrees (in the sensor)"
        default y
        help
            The OV2640 module on the Freenove board is mounted upside down.
endmenu
```

## display_p4/main/Kconfig.projbuild
```kconfig
menu "Wireless camera"
    config CAM_AP_SSID
        string "Wi-Fi name of the camera"
        default "JC8012-CAM"
    config CAM_AP_PASSWORD
        string "Wi-Fi password of the camera"
        default "jc8012cam"
    config CAM_STREAM_URL
        string "MJPEG stream URL"
        default "http://192.168.4.1/stream"
endmenu
```

## display_p4/sdkconfig.defaults
```kconfig
# Guition JC8012P4A1C_I_W_Y, ESP32-P4 rev v3.x
CONFIG_IDF_TARGET="esp32p4"
CONFIG_IDF_EXPERIMENTAL_FEATURES=y
CONFIG_ESPTOOLPY_FLASHMODE_QIO=y
CONFIG_ESPTOOLPY_FLASHSIZE_16MB=y
CONFIG_SPIRAM=y
CONFIG_SPIRAM_SPEED_200M=y
CONFIG_SPIRAM_XIP_FROM_PSRAM=y
CONFIG_CACHE_L2_CACHE_256KB=y
CONFIG_CACHE_L2_CACHE_LINE_128B=y
CONFIG_BOOTLOADER_LOG_LEVEL_WARN=y
CONFIG_COMPILER_OPTIMIZATION_PERF=y
CONFIG_FREERTOS_HZ=1000
CONFIG_ESP_MAIN_TASK_STACK_SIZE=6144

# Wi-Fi through the on-board ESP32-C6 (ESP-Hosted over SDIO, P4 Function EV Board pins)
CONFIG_ESP_HOSTED_SDIO_HOST_INTERFACE=y
CONFIG_SLAVE_IDF_TARGET_ESP32C6=y
CONFIG_ESP_HOSTED_SDIO_4_BIT_BUS=y
CONFIG_ESP_HOSTED_SDIO_CLOCK_FREQ_KHZ=40000

# TCP receive tuning for the video stream
CONFIG_LWIP_TCP_WND_DEFAULT=32768
CONFIG_LWIP_TCP_RECVMBOX_SIZE=32
CONFIG_LWIP_TCPIP_RECVMBOX_SIZE=64
CONFIG_LWIP_TCP_SND_BUF_DEFAULT=16384
```
